# SIG_1.0 register map
Vendor: Texas Instruments
Peripheral module from a debugger description file (folder msp).
Registers are 32-bit, read-write, no defined reset value unless marked. A register's access mark holds for its fields unless they carry their own. Offsets are as the file gives them; lines under a group give offsets from that group; [hi:lo] are bit positions; {n}, {i} and the like mark numbered series; 'fields as' and 'values as' point back to an identical list; <NAME> marks a mode.

## SIG
0xE000EF00 SIG_STIR — Provides a mechanism for software to generate an interrupt
  [8:0] INTID — Indicates the interrupt to be pended. The value written is (ExceptionNumber - 16)
